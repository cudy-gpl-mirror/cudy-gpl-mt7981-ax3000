## 21.02/package/mtk/uboot-atf-mtk/Config.in
```kconfig
menu "Configuration"

config UBOOT_NAND
	bool "custom config for uboot support nand flash."
	default n
	help
		This is custom config for uboot support nand flash.
endmenu
```
